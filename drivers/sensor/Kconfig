## drivers/sensor/Kconfig
```kconfig
# Copyright (c) 2022 Nordic Semiconductor ASA
# SPDX-License-Identifier: Apache-2.0

if SENSOR
rsource "sensornode/Kconfig"
endif # SENSOR
```

## drivers/sensor/sensornode/Kconfig
```kconfig
# Copyright (c) 2022 Nordic Semiconductor ASA
# SPDX-License-Identifier: Apache-2.0

config JM101
	bool "sensor node boool"
	default y
	select GPIO
	select SERIAL
	select UART_INTERRUPT_DRIVEN
	help
	  sensornode .
```

## dts/bindings/sensor/sensor,sensornode.yaml
```yaml
# Copyright (c) 2022 Nordic Semiconductor ASA
# SPDX-License-Identifier: Apache-2.0

description: |
  sensor node driver having three sensors

compatible: "sensor,sensornode"

include: base.yaml

properties:
  reg:
    required: true
```
