/*
 * Copyright (c) 2022 Nordic Semiconductor ASA
 * SPDX-License-Identifier: Apache-2.0
 */

&uart0 {
  compatible = "sensor,sensornode";
  status = "okay";
  current-speed = <115200>;
  /* other properties */
};

